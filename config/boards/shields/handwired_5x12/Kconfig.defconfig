## config/boards/shields/handwired_5x12/Kconfig.defconfig
```kconfig
if SHIELD_HANDWIRED_5X12

config ZMK_KEYBOARD_NAME
    default "Handwired 5x12"

endif
```

## config/boards/shields/handwired_5x12/Kconfig.shield
```kconfig
config SHIELD_HANDWIRED_5X12
    def_bool $(shields_list_contains,handwired_5x12)
```

## config/boards/shields/handwired_5x15/Kconfig.defconfig
```kconfig
if SHIELD_HANDWIRED_5X15

config ZMK_KEYBOARD_NAME
    default "Handwired 5x15"

endif
```

## config/boards/shields/handwired_5x15/Kconfig.shield
```kconfig
config SHIELD_HANDWIRED_5X15
    def_bool $(shields_list_contains,handwired_5x15)
```
